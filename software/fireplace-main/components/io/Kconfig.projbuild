## software/fireplace-main/components/io/Kconfig.projbuild
```kconfig
menu "FiReplace Output Configuration"

    config FIREPLACE_OUT_IN1_GPIO
        int "H-bridge IN1 GPIO"
        range 0 48
        default 4
        help
            Driven high (with IN2 low) to pulse the fireplace on.

    config FIREPLACE_OUT_IN2_GPIO
        int "H-bridge IN2 GPIO"
        range 0 48
        default 5
        help
            Driven high (with IN1 low) to pulse the fireplace off.

    config FIREPLACE_PULSE_MS
        int "Output pulse length, unit: ms"
        range 10 60000
        default 6000
        help
            How long the on or off pulse is held before both outputs are released.

endmenu
```

## software/fireplace-main/components/tasks/Kconfig.projbuild
```kconfig
menu "FiReplace Control Configuration"

    config FIREPLACE_TEMP_HYSTERESIS
        int "Temperature hysteresis, unit: degrees F"
        range 0 20
        default 2
        help
            After the set temperature is reached the fireplace stays off until the
            temperature drops this many degrees below the set temperature.

    config FIREPLACE_SENSOR_TIMEOUT_SECONDS
        int "Sensor timeout, unit: seconds"
        range 1 86400
        default 300
        help
            If no sensor reading arrives within this time, or none has arrived since
            boot, the fireplace is forced off. The sensor reports every 60 seconds.

    config FIREPLACE_MAX_ON_SECONDS
        int "Maximum on time, unit: seconds"
        range 60 604800
        default 21600
        help
            The fireplace is forced off this long after the remote turned it on.
            It stays off until the remote turns it off and on again.

endmenu
```

## software/fireplace-remote/components/link/Kconfig.projbuild
```kconfig
menu "FiReplace ESP-NOW Link Configuration"

    choice ESPNOW_WIFI_MODE
        prompt "WiFi mode"
        default ESPNOW_WIFI_MODE_STATION
        help
            WiFi mode used for the ESP-NOW link (station or softap).
            Must match the mode set in link.c:init_wifi() (currently WIFI_MODE_STA).

        config ESPNOW_WIFI_MODE_STATION
            bool "Station"
        config ESPNOW_WIFI_MODE_STATION_SOFTAP
            bool "Softap"
    endchoice

    config ESPNOW_CHANNEL
        int "Channel"
        default 1
        range 0 14
        help
            The channel on which sending and receiving ESPNOW data.
            0 means "use whatever channel WiFi is already on".

    config ESPNOW_SEND_COUNT
        int "Send count"
        default 100
        range 1 65535
        help
            Total count of unicast ESPNOW data to be sent (sender devices only).

    config ESPNOW_SEND_DELAY
        int "Send delay"
        default 1000
        range 0 65535
        help
            Delay between sending two ESPNOW data, unit: ms.

    config ESPNOW_SEND_LEN
        int "Send len"
        range 10 1470
        default 16
        help
            Length of the ESPNOW data buffer, unit: byte.
            Must be at least sizeof(fireplace_espnow_data_t) + sizeof(fireplace_payload_t) (13 bytes).

    config ESPNOW_ENABLE_POWER_SAVE
        bool "Enable ESPNOW Power Save"
        default n
        select ESP_WIFI_STA_DISCONNECTED_PM_ENABLE
        depends on ESPNOW_WIFI_MODE_STATION
        help
            With ESPNOW power save enabled, the chip can wake up and sleep periodically.
            Leave disabled for mains-powered devices (e.g. the main/receiver controller)
            that need to stay awake to receive from peers at any time.

    config ESPNOW_WAKE_WINDOW
        int "ESPNOW wake window, unit in millisecond"
        range 0 65535
        default 50
        depends on ESPNOW_ENABLE_POWER_SAVE
        help
            ESPNOW wake window.

    config ESPNOW_WAKE_INTERVAL
        int "ESPNOW wake interval, unit in millisecond"
        range 1 65535
        default 100
        depends on ESPNOW_ENABLE_POWER_SAVE
        help
            ESPNOW wake interval.

endmenu
```
